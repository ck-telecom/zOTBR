## boards/arm/pitaya_go/Kconfig
```kconfig
# nRF52840 PitayaGo board configuration
# Copyright (c) 2022 Qingsong Gou <gouqs@hotmail.com>
# SPDX-License-Identifier: Apache-2.0

if BOARD_PITAYA_GO

config BOARD_ENABLE_DCDC
	bool "DCDC mode"
	select SOC_DCDC_NRF52X
	default y
endif # BOARD_PITAYA_GO
```

## boards/arm/pitaya_go/Kconfig.board
```kconfig
# nRF52840 PitayaGo board configuration
# Copyright (c) 2022 Qingsong Gou <gouqs@hotmail.com>
# SPDX-License-Identifier: Apache-2.0

config BOARD_PITAYA_GO
	bool "nRF52840 PitayaGo"
	depends on SOC_NRF52840_QIAA
```

## boards/arm/pitaya_go/Kconfig.defconfig
```kconfig
# nRF52840 MDK USB Dongle board configuration
#
# Copyright (c) 2018 Nordic Semiconductor ASA
#
# Copyright (c) 2022 Nikola Trifunovic
#
# SPDX-License-Identifier: Apache-2.0

if BOARD_PITAYA_GO

config BOARD
	default "nrf52840_pitaya_go"


if USB_DEVICE_STACK

# Enable UART driver, needed for CDC ACM
config SERIAL
	default y

endif # USB_DEVICE_STACK

config BT_CTLR
	default BT

endif # BOARD_PITAYA_GO
```
